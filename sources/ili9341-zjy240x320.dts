/*
 * Device Tree Overlay for ZJY240S0800TG02 Display (ILI9341 Controller)
 * 
 * Generic overlay supporting multiple orientations
 * Display model: ZJY240S0800TG02 (2.4" 320x240 QVGA)
 * Controller: ILI9341
 * Interface: 4-wire SPI
 * 
 * Hardware connections (Audiophonics RASPDAC MINI LCD pinout):
 *   GPIO 27 - DC (Data/Command)
 *   GPIO 24 - RESET
 *   GPIO 18 - LED (Backlight)
 *   GPIO 10 - MOSI (SPI Data)
 *   GPIO 11 - SCLK (SPI Clock)
 *   GPIO 8  - CE0 (Chip Select)
 * 
 * Rotation configurations:
 *   rotation=0   (default): Portrait 240x320, MADCTL 0x88, pins BOTTOM
 *   rotation=90:            Landscape 320x240, MADCTL 0xe8, pins RIGHT (RASPDAC MINI)
 *   rotation=180:           Portrait 240x320, MADCTL 0x48, pins TOP
 *   rotation=270:           Landscape 320x240, MADCTL 0x28, pins LEFT
 * 
 * Usage examples:
 *   dtoverlay=ili9341-zjy240x320                    (default: rotation=0)
 *   dtoverlay=ili9341-zjy240x320,rotation=0         (pins BOTTOM)
 *   dtoverlay=ili9341-zjy240x320,rotation=90        (pins RIGHT)
 *   dtoverlay=ili9341-zjy240x320,rotation=180       (pins TOP)
 *   dtoverlay=ili9341-zjy240x320,rotation=270       (pins LEFT)
 *   dtoverlay=ili9341-zjy240x320,rotation=90,speed=32000000
 * 
 * Parameters:
 *   rotation - Display rotation in degrees (0, 90, 180, 270, default: 0)
 *   speed    - SPI bus speed in Hz (default: 64000000)
 *   fps      - Refresh rate (default: 30)
 * 
 * Technical notes:
 *   - BGR mode enabled (hardware has R/B channels swapped)
 *   - Buswidth 8 (not 16)
 *   - All configurations use rotate=1 with different MADCTL values
 *   - Tested and validated on Raspberry Pi 4 Model B
 */

/dts-v1/;
/plugin/;

/ {
    compatible = "brcm,bcm2835";

    fragment@0 {
        target = <&spi0>;
        __overlay__ {
            status = "okay";
        };
    };

    fragment@1 {
        target = <&spidev0>;
        __overlay__ {
            status = "disabled";
        };
    };

    /* Base configuration: Portrait, pins BOTTOM (MADCTL 0x88) */
    fragment@2 {
        target = <&spi0>;
        __overlay__ {
            #address-cells = <1>;
            #size-cells = <0>;

            display: display@0 {
                compatible = "ilitek,ili9341";
                reg = <0>;
                spi-max-frequency = <64000000>;
                reset-gpios = <&gpio 24 1>;
                dc-gpios = <&gpio 27 0>;
                width = <240>;
                height = <320>;
                buswidth = <8>;
                bgr;
                fps = <30>;
                rotate = <1>;
                init = <0x01000001
                        0x02000005
                        0x01000028
                        0x010000cf 0x00 0x83 0x30
                        0x010000ed 0x64 0x03 0x12 0x81
                        0x010000e8 0x85 0x01 0x79
                        0x010000cb 0x39 0x2c 0x00 0x34 0x02
                        0x010000f7 0x20
                        0x010000ea 0x00 0x00
                        0x010000c0 0x26
                        0x010000c1 0x11
                        0x010000c5 0x35 0x3e
                        0x010000c7 0xbe
                        0x0100003a 0x55
                        0x01000036 0x88
                        0x010000b1 0x00 0x1b
                        0x01000026 0x01
                        0x010000f2 0x08
                        0x01000026 0x01
                        0x010000e0 0x1f 0x1a 0x18 0x0a 0x0f 0x06 0x45 0x87 0x32 0x0a 0x07 0x02 0x07 0x05 0x00
                        0x010000e1 0x00 0x25 0x27 0x05 0x10 0x09 0x3a 0x78 0x4d 0x05 0x18 0x0d 0x38 0x3a 0x1f
                        0x010000b7 0x07
                        0x010000b6 0x0a 0x82 0x27 0x00
                        0x01000011
                        0x02000064
                        0x01000029
                        0x02000064>;
            };
        };
    };

    /* Override for rotation=90: pins RIGHT, MADCTL 0xe8 */
    fragment@3 {
        target = <&display>;
        __dormant__;
        __overlay__ {
            width = <320>;
            height = <240>;
            init = <0x01000001
                    0x02000005
                    0x01000028
                    0x010000cf 0x00 0x83 0x30
                    0x010000ed 0x64 0x03 0x12 0x81
                    0x010000e8 0x85 0x01 0x79
                    0x010000cb 0x39 0x2c 0x00 0x34 0x02
                    0x010000f7 0x20
                    0x010000ea 0x00 0x00
                    0x010000c0 0x26
                    0x010000c1 0x11
                    0x010000c5 0x35 0x3e
                    0x010000c7 0xbe
                    0x0100003a 0x55
                    0x01000036 0xe8
                    0x010000b1 0x00 0x1b
                    0x01000026 0x01
                    0x010000f2 0x08
                    0x01000026 0x01
                    0x010000e0 0x1f 0x1a 0x18 0x0a 0x0f 0x06 0x45 0x87 0x32 0x0a 0x07 0x02 0x07 0x05 0x00
                    0x010000e1 0x00 0x25 0x27 0x05 0x10 0x09 0x3a 0x78 0x4d 0x05 0x18 0x0d 0x38 0x3a 0x1f
                    0x010000b7 0x07
                    0x010000b6 0x0a 0x82 0x27 0x00
                    0x01000011
                    0x02000064
                    0x01000029
                    0x02000064>;
        };
    };

    /* Override for rotation=180: pins TOP, MADCTL 0x48 */
    fragment@4 {
        target = <&display>;
        __dormant__;
        __overlay__ {
            width = <240>;
            height = <320>;
            init = <0x01000001
                    0x02000005
                    0x01000028
                    0x010000cf 0x00 0x83 0x30
                    0x010000ed 0x64 0x03 0x12 0x81
                    0x010000e8 0x85 0x01 0x79
                    0x010000cb 0x39 0x2c 0x00 0x34 0x02
                    0x010000f7 0x20
                    0x010000ea 0x00 0x00
                    0x010000c0 0x26
                    0x010000c1 0x11
                    0x010000c5 0x35 0x3e
                    0x010000c7 0xbe
                    0x0100003a 0x55
                    0x01000036 0x48
                    0x010000b1 0x00 0x1b
                    0x01000026 0x01
                    0x010000f2 0x08
                    0x01000026 0x01
                    0x010000e0 0x1f 0x1a 0x18 0x0a 0x0f 0x06 0x45 0x87 0x32 0x0a 0x07 0x02 0x07 0x05 0x00
                    0x010000e1 0x00 0x25 0x27 0x05 0x10 0x09 0x3a 0x78 0x4d 0x05 0x18 0x0d 0x38 0x3a 0x1f
                    0x010000b7 0x07
                    0x010000b6 0x0a 0x82 0x27 0x00
                    0x01000011
                    0x02000064
                    0x01000029
                    0x02000064>;
        };
    };

    /* Override for rotation=270: pins LEFT, MADCTL 0x28 */
    fragment@5 {
        target = <&display>;
        __dormant__;
        __overlay__ {
            width = <320>;
            height = <240>;
            init = <0x01000001
                    0x02000005
                    0x01000028
                    0x010000cf 0x00 0x83 0x30
                    0x010000ed 0x64 0x03 0x12 0x81
                    0x010000e8 0x85 0x01 0x79
                    0x010000cb 0x39 0x2c 0x00 0x34 0x02
                    0x010000f7 0x20
                    0x010000ea 0x00 0x00
                    0x010000c0 0x26
                    0x010000c1 0x11
                    0x010000c5 0x35 0x3e
                    0x010000c7 0xbe
                    0x0100003a 0x55
                    0x01000036 0x28
                    0x010000b1 0x00 0x1b
                    0x01000026 0x01
                    0x010000f2 0x08
                    0x01000026 0x01
                    0x010000e0 0x1f 0x1a 0x18 0x0a 0x0f 0x06 0x45 0x87 0x32 0x0a 0x07 0x02 0x07 0x05 0x00
                    0x010000e1 0x00 0x25 0x27 0x05 0x10 0x09 0x3a 0x78 0x4d 0x05 0x18 0x0d 0x38 0x3a 0x1f
                    0x010000b7 0x07
                    0x010000b6 0x0a 0x82 0x27 0x00
                    0x01000011
                    0x02000064
                    0x01000029
                    0x02000064>;
        };
    };

    __overrides__ {
        rotation = <0>,"=0","!3","!4","!5",
                   <0>,"=90","+3","!4","!5",
                   <0>,"=180","!3","+4","!5",
                   <0>,"=270","!3","!4","+5";
        speed = <&display>,"spi-max-frequency:0";
        fps = <&display>,"fps:0";
    };
};
